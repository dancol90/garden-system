#define font_w 16
#define font_h 22

#define row_size  2  // (font_w / 8) arrotondato per eccesso
#define char_size 44 // row_size * font_h

static unsigned const char numbers[] PROGMEM = {
   0xE0,0x07,0xF8,0x1F,0xFC,0x3F,0xFC,0x3F,0x7E,0x7E,0x3E,0x7C,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0x07, // Code for char num 48
   0x00,0x0F,0x80,0x0F,0xE0,0x0F,0xF8,0x0F,0xFC,0x0F,0xFC,0x0F,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0x0F, // Code for char num 49
   0xF0,0x03,0xFC,0x0F,0xFE,0x1F,0xFF,0x3F,0x1E,0x3F,0x04,0x3E,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0x7F, // Code for char num 50
   0xF8,0x03,0xFE,0x0F,0xFF,0x1F,0xFE,0x1F,0x06,0x3F,0x00,0x3E,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0x03, // Code for char num 51
   0x00,0x3E,0x00,0x3F,0x80,0x3F,0xC0,0x3F,0xE0,0x3F,0xE0,0x3F,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0x3E, // Code for char num 52
   0xFC,0x3F,0xFC,0x3F,0xFC,0x3F,0xFC,0x3F,0x3C,0x00,0x3C,0x00,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0x03, // Code for char num 53
   0x00,0x7C,0x80,0x7F,0xE0,0x7F,0xF0,0x7F,0xF8,0x07,0xFC,0x00,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0x07, // Code for char num 54
   0xFF,0xFF,0xFF,0xFF,0xFF,0xFF,0xFF,0xFF,0x00,0x7E,0x00,0x3F,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0x00, // Code for char num 55
   0xF0,0x07,0xF8,0x1F,0xFE,0x3F,0xFE,0x3F,0x3F,0x7E,0x1F,0x7C,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0x0F, // Code for char num 56
   0xE0,0x07,0xF8,0x1F,0xFC,0x3F,0xFE,0x7F,0x3E,0x7C,0x1F,0x7C,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0x00, // Code for char num 57
  
   0x00,0x00,0x00,0x00,0x00,0x00,0x00,0x00,0x00,0x00,0x00,0x00,0x00,0x00,0x00,0x3C,0x7E,0x7E,0x7E,0x7E,0x3C,0x00 // Code for char num 46
};

extern LightPCD8544 lcd;

void draw_big_digit(uint8_t xPos, uint8_t yPos, uint8_t digit) {
  uint8_t x, y, b, i, r = row_size;
  
  if(digit == '.') {
    digit = 10;
    
    r = row_size / 2;
  }
  
  for(y = 0; y < font_h; y++) {
    for(x = 0; x < r; x++) {
      b = pgm_read_byte(numbers + char_size * digit + r * y + x);
      
      for(i = 0; i < 8; i++)
        lcd.drawPixel(xPos + x*8 + i, yPos + y, b & _BV(i));
    }
  }
}
